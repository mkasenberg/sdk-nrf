## CMakeLists.txt
```
#
# Copyright (c) 2022 Nordic Semiconductor ASA
#
# SPDX-License-Identifier: LicenseRef-Nordic-5-Clause
#

cmake_minimum_required(VERSION 3.20.0)

set(DTC_OVERLAY_FILE "./nrf54.overlay")
find_package(Zephyr REQUIRED HINTS $ENV{ZEPHYR_BASE})
project(empty_net_core)

target_include_directories(app PRIVATE ./src)
# NORDIC SDK APP START
target_sources(app PRIVATE
        src/main.c
        )
# NORDIC SDK APP END
```

## sample.yaml
```
sample:
  description: Minimal configuration sample that works as empty netcore image.
  name: Empty firmware for network core
tests:
  sample.nrf5340.empty_net_core.build:
    sysbuild: true
    build_only: true
    integration_platforms:
      - nrf54h20dk/nrf54h20/cpurad
      - nrf5340dk/nrf5340/cpunet
      - thingy53/nrf5340/cpunet
    platform_allow: nrf5340dk/nrf5340/cpunet thingy53/nrf5340/cpunet nrf54h20dk/nrf54h20/cpurad
    tags: ci_build sysbuild
```

## prj.conf
```kconfig
# Intentionally empty

CONFIG_NRFS=n
CONFIG_MBOX=n
# Enable UART driver
CONFIG_SERIAL=n

# Enable console
CONFIG_CONSOLE=n
CONFIG_UART_CONSOLE=n

CONFIG_USE_DT_CODE_PARTITION=y

# Enable MPU
CONFIG_ARM_MPU=y

# Enable hardware stack protection
CONFIG_HW_STACK_PROTECTION=y

# MPU-based null-pointer dereferencing detection cannot be applied
# as the (0x0 - 0x400) region is unmapped for this target.
CONFIG_NULL_POINTER_EXCEPTION_DETECTION_NONE=y

# Enable cache
CONFIG_CACHE_MANAGEMENT=n
CONFIG_EXTERNAL_CACHE=n
```

## nrf54.overlay
```dts
/ {
    reserved-memory {
        #address-cells = <1>;
        #size-cells = <1>;
        ranges;

        mynewt_memory: memory@0e070000 {
            reg = <0x0e070000 0x00020000>;
            no-map;
        };
    };
};
```

## src/main.c
```c
/*
 * Copyright (c) 2023 Nordic Semiconductor ASA
 *
 * SPDX-License-Identifier: LicenseRef-Nordic-5-Clause
 */

#include <errno.h>
//#include <zephyr/logging/log.h>
#include <zephyr/kernel.h>

/* Access the Mynewt memory address and size */
#define MYNEWT_MEM_NODE DT_NODELABEL(mynewt_memory)

/* Get the starting address and size from the device tree */
#define MYNEWT_START_ADDR DT_REG_ADDR(MYNEWT_MEM_NODE)
#define MYNEWT_SIZE       DT_REG_SIZE(MYNEWT_MEM_NODE)

typedef void (*mynewt_entry_t)(void);
volatile int hello = 1;

int main(void)
{
    int err;

    mynewt_entry_t *mynewt_start = (mynewt_entry_t*)MYNEWT_START_ADDR;

    __set_PSPLIM(0);
    __set_MSPLIM(0);
    __set_MSP(mynewt_start[0]);
    __set_CONTROL(__get_CONTROL() & ~0x2);
    mynewt_start[1]();

    while(hello);

	return 0; /* Dummy application. Unused main */
}
```
